macro_screen_shot: macro_screen_shot {
        compatible = "zmk,behavior-macro";
        label = "macro_screen_shot";
        #binding-cells = <0>;
        wait-ms = <30>;
        tap-ms = <30>;
        bindings
            = <&kp LC(LS(S))>;
    };
macro_emoji: macro_emoji {
        compatible = "zmk,behavior-macro";
        label = "macro_emoji";
        #binding-cells = <0>;
        wait-ms = <30>;
        tap-ms = <30>;
        bindings
            = <&kp LC(LG(SPACE))>;
    };
macro_jump: macro_jump {
        compatible = "zmk,behavior-macro";
        label = "macro_emoji";
        #binding-cells = <0>;
        wait-ms = <30>;
        tap-ms = <30>;
        bindings
            = <&kp LC(GRAVE)>;
    };